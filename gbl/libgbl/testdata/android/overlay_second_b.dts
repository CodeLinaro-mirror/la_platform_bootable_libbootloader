/dts-v1/;
/plugin/;

/ {
    fragment@0 {
        target-path = "/chosen";
        __overlay__ {
            // This is the latest overlay to be applied, so this value must be appended by GBL.
            bootargs_ext = "fragment_overlay_bootargs_ext";
            first_overlay {
                second_overlay_b_property = "second_overlay_b_val";
            };
        };
    };
};
