/dts-v1/;
/plugin/;

/ {
    chosen {
        // To be appended by GBL.
        bootargs_ext = "overlay_bootargs_ext";
    };

    // add a new node at the root level
    fragment@0 {
        target-path = "/chosen";
        __overlay__ {
            // Add the node with property to this sub-node
            first_overlay {
                overlay_a_property = "overlay_a_val";
            };
        };
    };
};
