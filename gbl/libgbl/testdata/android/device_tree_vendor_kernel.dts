/dts-v1/;

/ {
    info = "test device tree for vendor_kernel_boot";

    chosen {
        bootargs = "existing_arg_1=existing_val_1 existing_arg_2=existing_val_2";
        fixup = <0x0>;
        vendor_kernel = "1";
    };
};
